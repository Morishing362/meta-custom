## conf/layer.conf
```bitbake
# We have a conf and classes directory, add to BBPATH
BBPATH .= ":${LAYERDIR}"

# We have recipes-* directories, add to BBFILES
BBFILES += "${LAYERDIR}/recipes-*/*/*.bb \
            ${LAYERDIR}/recipes-*/*/*.bbappend"

BBFILE_COLLECTIONS += "meta-custom"
BBFILE_PATTERN_meta-custom = "^${LAYERDIR}/"
BBFILE_PRIORITY_meta-custom = "6"

LAYERDEPENDS_meta-custom = "core"
LAYERSERIES_COMPAT_meta-custom = "kirkstone"

#
# My build/conf/local.conf here !!!
#

# core-image-weston config
# LICENSE_FLAGS_ACCEPTED = "synaptics-killswitch"

# Waveshare dispaly config
# KERNEL_DEVICETREE += " \
#     overlays/vc4-kms-v3d.dtbo \
#     overlays/vc4-kms-dsi-7inch.dtbo \
# "
#
```
